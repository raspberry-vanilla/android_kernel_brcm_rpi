## drivers/android/wrapfd/Kconfig
```kconfig
# SPDX-License-Identifier: GPL-2.0

config ANDROID_WRAPFD
	bool "WrapFD Driver (Rust)"
	depends on RUST && MMU && 64BIT
	help
	  Enables the Rust implementation of the WrapFD driver to control
          ability to map a file.

	  WrapFD allows wrapping an fd representing a memory buffer into a new
	  file supporting ioctl API for file ownership that controls ability to
	  map the file.
```

## net/apf/Kconfig
```kconfig
# SPDX-License-Identifier: GPL-2.0-only
#
# Copyright 2026 Google LLC
#
# Kconfig for the Advanced Packet Filter (APF) subsystem
#

config NET_APF
	bool "Advanced Packet Filter (APF) Subsystem"
	depends on NET
	help
	  This enables the Advanced Packet Filter (APF) subsystem, which provides
	  a generic netlink interface for userspace to configure network driver
	  and firmware implemented packet filtering capabilities.

	  If you are building a kernel that uses APF, say Y.
```
